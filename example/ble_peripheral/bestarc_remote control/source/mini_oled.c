#include "mini_oled.h"
#include "gpio.h"
#include "i2c.h"
#include "bus_dev.h"
#include "log.h"
#include "error.h"
#include "mcu.h"
#include <string.h>

#define OLED_ADDR        0x3Cu
#define OLED_PIN_SCL     GPIO_P32
#define OLED_PIN_SDA     GPIO_P33
#define OLED_I2C_DEV     I2C_1
#define OLED_I2C_PORT    AP_I2C1
#define OLED_WIDTH       128u
#define OLED_HEIGHT      64u
#define OLED_PAGES       8u
#define OLED_FONT_W      6u
#define OLED_FONT_H      8u
#define OLED_DATA_CHUNK  16u

static uint8_t s_fb[OLED_WIDTH * OLED_PAGES];
static uint8_t s_ready = 0;
static uint8_t s_i2c_error_logged = 0;

static const uint8_t s_font[96][6] = {
    {0x00,0x00,0x00,0x00,0x00,0x00}, {0x00,0x00,0x5F,0x00,0x00,0x00},
    {0x00,0x07,0x00,0x07,0x00,0x00}, {0x14,0x7F,0x14,0x7F,0x14,0x00},
    {0x24,0x2A,0x7F,0x2A,0x12,0x00}, {0x23,0x13,0x08,0x64,0x62,0x00},
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    {0x08,0x04,0x08,0x10,0x08,0x00}, {0x00,0x00,0x00,0x00,0x00,0x00}
};

static const uint8_t s_init_seq[] = {
    0xAE,
    0xD5, 0x80,
    0xA8, 0x3F,
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    0xA6,
    0xAF
};

static void _delay_ms(uint16 ms)
{
    while (ms--) {
        volatile uint32_t d = 24000;
        while (d--) { __NOP(); }
    }
}

static uint8_t _i2c_write(const uint8_t* data, uint8_t len)
{
    int ret;

    HAL_ENTER_CRITICAL_SECTION();
    ret = hal_i2c_addr_update(OLED_I2C_PORT, OLED_ADDR);
    if (ret == PPlus_SUCCESS) {
        ret = hal_i2c_tx_start(OLED_I2C_PORT);
    }
    HAL_EXIT_CRITICAL_SECTION();

    if (ret == PPlus_SUCCESS) {
        ret = hal_i2c_send(OLED_I2C_PORT, (uint8_t*)data, len);
    }

    if (ret != PPlus_SUCCESS) {
        if (!s_i2c_error_logged) {
            LOG("[OLED] I2C write failed: ret=%d len=%d\n", ret, len);
            s_i2c_error_logged = 1;
        }
        return 0;
    }

    return 1;
}

static uint8_t _cmd(uint8_t cmd)
{
    uint8_t buf[2] = {0x00, cmd};
    return _i2c_write(buf, sizeof(buf));
}

static uint8_t _cmd2(uint8_t cmd, uint8_t arg)
{
    uint8_t buf[3] = {0x00, cmd, arg};
    return _i2c_write(buf, sizeof(buf));
}

static uint8_t _data128(const uint8_t* data)
{
    uint8_t offset = 0;
    uint8_t buf[1 + OLED_DATA_CHUNK];

    buf[0] = 0x40;
    while (offset < OLED_WIDTH) {
        memcpy(&buf[1], &data[offset], OLED_DATA_CHUNK);
        if (!_i2c_write(buf, sizeof(buf))) {
            return 0;
        }
        offset += OLED_DATA_CHUNK;
    }

    return 1;
}

void oled_set_pixel(uint8_t x, uint8_t y, uint8_t on)
{
    uint16 idx;

    if (x >= OLED_WIDTH || y >= OLED_HEIGHT) return;

    idx = x + (y / 8u) * OLED_WIDTH;
    if (on) s_fb[idx] |= (1u << (y % 8u));
    else s_fb[idx] &= ~(1u << (y % 8u));
}

void oled_clear(void)
{
    memset(s_fb, 0, sizeof(s_fb));
}

uint8_t oled_flush(void)
{
    uint8_t page;

    for (page = 0; page < OLED_PAGES; page++) {
        if (!_cmd2(0xB0 | page, 0x00)) return 0;
        if (!_cmd(0x10)) return 0;
        if (!_data128(&s_fb[page * OLED_WIDTH])) return 0;
    }

    return 1;
}

void oled_draw_char(uint8_t x, uint8_t y, char c)
{
    uint8_t i, j, idx;
    uint8_t col;

    if (c < 32 || c > 127) c = ' ';
    idx = (uint8_t)c - 32;

    for (i = 0; i < OLED_FONT_W; i++) {
        if ((uint8_t)(x + i) >= OLED_WIDTH) continue;
        col = s_font[idx][i];

        for (j = 0; j < OLED_FONT_H; j++) {
            oled_set_pixel((uint8_t)(x + i), y + j, (col >> j) & 1u);
        }
    }
}

void oled_draw_str(uint8_t x, uint8_t y, const char* str)
{
    while (*str) {
        oled_draw_char(x, y, *str++);
        x += OLED_FONT_W;
    }
}

uint8_t oled_init(void)
{
    uint8_t i;
    void* pi2c;

    s_ready = 0;
    s_i2c_error_logged = 0;

    hal_gpio_pin_init(OLED_PIN_SDA, GPIO_INPUT);
    hal_gpio_pin_init(OLED_PIN_SCL, GPIO_INPUT);
    hal_gpio_pull_set(OLED_PIN_SDA, STRONG_PULL_UP);
    hal_gpio_pull_set(OLED_PIN_SCL, STRONG_PULL_UP);

    if (hal_i2c_pin_init(OLED_I2C_DEV, OLED_PIN_SDA, OLED_PIN_SCL) != PPlus_SUCCESS) {
        LOG("[OLED] I2C pin init failed\n");
        return 0;
    }

    pi2c = hal_i2c_init(OLED_I2C_DEV, I2C_CLOCK_100K);
    if (pi2c == NULL) {
        LOG("[OLED] I2C init failed\n");
        return 0;
    }

    _delay_ms(50);

    for (i = 0; i < sizeof(s_init_seq); i++) {
        if (!_cmd(s_init_seq[i])) {
            LOG("[OLED] SSD1306 init failed at cmd %d\n", i);
            return 0;
        }
    }

    oled_clear();
    if (!oled_flush()) {
        LOG("[OLED] first flush failed\n");
        return 0;
    }

    s_ready = 1;
    LOG("[OLED] SSD1306 128x64 ready (mini driver, addr=0x%02X, I2C=100K)\n", OLED_ADDR);
    return 1;
}

uint8_t oled_ready(void)
{
    return s_ready;
}
